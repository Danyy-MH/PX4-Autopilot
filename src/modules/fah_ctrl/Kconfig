## src/modules/fah_ctrl/Kconfig
```kconfig
menuconfig MODULES_FAH_CTRL
	bool "fah_ctrl"
	default n
	---help---
		Enable Controller Parameters for Simulink App
```

## src/modules/fah_obs/Kconfig
```kconfig
menuconfig MODULES_FAH_OBS
	bool "fah_obs"
	default n
	---help---
		Enable Estimator Parameters for Simulink App
```
